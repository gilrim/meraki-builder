## buildroot/packages/Config.in
```kconfig
menu "MS42P custom packages"
	source "package/click/Config.in"
	source "package/status/Config.in"
	source "package/configd/Config.in"
	source "package/findhdr/Config.in"
	source "package/pd690xx/Config.in"
	source "package/fwupdate/Config.in"
	source "package/postmerkos-cli/Config.in"
endmenu
```

## buildroot/packages/configd/Config.in
```kconfig
config BR2_PACKAGE_CONFIGD
	bool "postmerkOS configuration core"
	select BR2_PACKAGE_JSON_C
	select BR2_PACKAGE_PD690XX
	help
	  Persistent switch configuration, hardware control, validation, and
	  one-shot console commands. This core is required by the text console
	  and does not require the optional web interface.

config BR2_PACKAGE_CONFIGD_WEBSOCKET
	bool "configd WebSocket service"
	depends on BR2_PACKAGE_CONFIGD
	select BR2_PACKAGE_LIBWEBSOCKETS
	help
	  Add the authenticated WebSocket daemon used by postmerkos-ui. Leave
	  disabled in console-only builds to save SquashFS space.
```

## buildroot/packages/findhdr/Config.in
```kconfig
config BR2_PACKAGE_FINDHDR
	bool "find_hdr"
	help
	  Locate the embedded ramdisk offset in supported Meraki firmware images.
```

## buildroot/packages/postmerkos-cli/Config.in
```kconfig
config BR2_PACKAGE_POSTMERKOS_CLI
	bool "postmerkOS management CLI"
	select BR2_PACKAGE_CONFIGD
	select BR2_PACKAGE_FWUPDATE
	select BR2_PACKAGE_JQ
	help
	  Interactive and scriptable management interface for postmerkOS switch
	  configuration, plain JSON backup/restore, and firmware updates.
```

## buildroot/packages/postmerkos-console/Config.in
```kconfig
config BR2_PACKAGE_POSTMERKOS_CONSOLE
	bool "postmerkOS console management interface"
	select BR2_PACKAGE_CONFIGD
	select BR2_PACKAGE_FWUPDATE
	help
	  Lightweight hierarchical text management interface for interactive
	  SSH and TTL serial sessions. It is the primary switch UI and is
	  included independently of the optional web interface.
```

## buildroot/packages/postmerkos-hardware/Config.in
```kconfig
config BR2_PACKAGE_POSTMERKOS_HARDWARE
	bool "postmerkOS hardware policy helpers"
	default y
	select BR2_PACKAGE_CONFIGD
	select BR2_PACKAGE_FWUPDATE
	select BR2_PACKAGE_JSON_C
	help
	  Capability-v3 chassis hardware support, including exact-model GPIO
	  discovery, verified reset-button hold handling, status-LED ownership,
	  firmware/reset indication, and one-shot PoE boot-prune policy.
	  Destructive reset is enabled only for hardware-verified profiles.
```

## buildroot/packages/status/Config.in
```kconfig
config BR2_PACKAGE_STATUS
	bool "clickswstatus"
	select BR2_PACKAGE_JSON_C
	select BR2_PACKAGE_PD690XX
	help
	  Read switch status directly from the Click filesystem. This utility is
	  optional because configd has its own status implementation for the web UI.
```
